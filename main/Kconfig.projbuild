## main/Kconfig.projbuild
```kconfig
menu "SmartAttendance Camera Configuration"

    choice SMARTATTENDANCE_CAMERA_SENSOR
        prompt "Camera sensor type"
        default CAMERA_SENSOR_OV2640
        help
            Select the camera sensor connected to the board.
            OV2640 uses the DVP (parallel) interface via esp_camera.
            OV5647 uses the MIPI-CSI 2-lane interface via esp_driver_cam.

        config CAMERA_SENSOR_OV2640
            bool "OV2640 (DVP / parallel interface)"
            help
                Use the OV2640 camera module via the legacy DVP interface.
                This uses the esp_camera component.

        config CAMERA_SENSOR_OV5647
            bool "OV5647 (MIPI-CSI 2-lane interface, ESP32-P4 only)"
            depends on IDF_TARGET_ESP32P4
            help
                Use the OV5647 MIPI-CSI camera module.
                Requires ESP32-P4 and the esp_driver_cam + esp_cam_sensor components.

    endchoice

endmenu
```

## managed_components/100312dog__opencv-mobile-prebuilt-picolibc/Kconfig
```kconfig
menu "OpenCV Modules"
    config OPENCV_MODULE_VIDEO
        bool "Enable Video module"
        default n
        help
            Enable OpenCV video module (video, background segmentation, tracking).

    config OPENCV_MODULE_PHOTO
        bool "Enable Photo module"
        default n
        help
            Enable OpenCV photo module (computational photography, HDR, denoising).

    config OPENCV_MODULE_FEATURES2D
        bool "Enable Features2D module"
        default n
        help
            Enable OpenCV features2d module (feature detectors, descriptors, matching).
endmenu
```

## sdkconfig.defaults
```kconfig
# ESP-IDF v6.0 compatible build defaults

# Compiler optimisation
CONFIG_COMPILER_OPTIMIZATION_SIZE=y
CONFIG_BOOTLOADER_COMPILER_OPTIMIZATION_SIZE=y

# CPU frequency — 360 MHz is guaranteed safe on ESP32-P4 rev < v3.0
# (400 MHz is not guaranteed on rev v1.x silicon per ESP-IDF warning)
CONFIG_ESP_DEFAULT_CPU_FREQ_MHZ_360=y

# NVS Encryption
# The nvs_keys partition is declared in partitions.csv.
# Scheme selection (HMAC-derived) is handled at runtime in main.c via
# nvs_flash_generate_keys() / nvs_flash_secure_init().
# CONFIG_NVS_ENCRYPTION is not set
CONFIG_NVS_SEC_HMAC_EFUSE_KEY_ID=3

# Main task stack (renamed in IDF v5.5+)
CONFIG_ESP_MAIN_TASK_STACK_SIZE=8192

# Chip revision — target ESP32-P4 rev v1.x silicon (hardware revision v1.3)
# Must be set to <3.0 for boards with ECO revision < v3.0
CONFIG_ESP32P4_SELECTS_REV_LESS_V3=y
CONFIG_ESP32P4_REV_MIN_FULL=100

# Camera sensor: SC2336 is the confirmed sensor on CrowPanel v1.0 (AS-AG638A32 M1-25)
# SCCB I2C address 0x36, format MIPI_2lane_24Minput_RAW8_1280x720_30fps
# CONFIG_CAMERA_SENSOR_OV2640 is NOT the sensor on this board
CONFIG_CAMERA_SENSOR_OV2640=n

# PSRAM Configuration – all symbols required for Hex-mode PSRAM at 200 MHz
CONFIG_SPIRAM=y
CONFIG_SPIRAM_MODE_HEX=y
CONFIG_SPIRAM_USE_MALLOC=y
CONFIG_SPIRAM_BOOT_INIT=y
CONFIG_SPIRAM_ALLOW_STACK_EXTERNAL_MEMORY=y
# CONFIG_SPIRAM_ALLOW_BSS_SEG_EXTERNAL_MEMORY is not set
CONFIG_SPIRAM_RODATA=y

# Reserve enough internal DMA RAM for SDIO Wi-Fi (esp_hosted) mempool.
# 131072 = 128KB needed to keep FreeRTOS TCBs in internal DRAM with PSRAM malloc.
CONFIG_SPIRAM_MALLOC_ALWAYSINTERNAL=131072
CONFIG_SPIRAM_MALLOC_RESERVE_INTERNAL=131072

# Disable esp_hosted mempool to avoid competing for DMA RAM at boot.
# SDIO driver will use the heap instead.
CONFIG_ESP_HOSTED_USE_MEMPOOL=n

# CRITICAL: Do NOT restart the host when SDIO fails to reach the C6 slave.
# When the C6 coprocessor doesn't respond (e.g. missing firmware), the SDIO
# driver would call esp_restart(), causing an infinite boot-loop.
# With this disabled, the app continues without WiFi/BLE instead of crashing.
CONFIG_ESP_HOSTED_TRANSPORT_RESTART_ON_FAILURE=n

# OpenCV-Mobile selection for ESP32-P4 (typically uses Picolibc)
CONFIG_OPENCV_PREBUILT_PICOLIBC=y
CONFIG_DW_GDMA_OBJ_DRAM_SAFE=y
CONFIG_DW_GDMA_ISR_IRAM_SAFE=y
# CONFIG_DMA2D_ISR_IRAM_SAFE is not set
CONFIG_DMA2D_OPERATION_FUNC_IN_IRAM=y
CONFIG_I2C_ISR_IRAM_SAFE=y
CONFIG_LCD_DSI_ISR_IRAM_SAFE=y
CONFIG_CAM_CTLR_MIPI_CSI_ISR_CACHE_SAFE=y
CONFIG_SPIRAM_SPEED_200M=y
CONFIG_SPIRAM_SPEED=200
CONFIG_IDF_EXPERIMENTAL_FEATURES=y

# DSI Panel IO – required for EK79007 MIPI-DSI display
CONFIG_LCD_DSI_PANEL_IO=y

# Face recognition model location: 2 = SD card
CONFIG_HUMAN_FACE_RECOGNITION_MODEL_LOCATION=2
CONFIG_HUMAN_FACE_RECOGNITION_MODEL_SDCARD_DIR="models/p4"
CONFIG_HUMAN_FACE_RECOGNITION_DEFAULT_MODEL=0

# SD card mount point
CONFIG_BSP_SD_MOUNT_POINT="/sdcard"

# Touch driver uses new i2c_master API (I2C_NUM_0, GPIO 45/46)
# Camera SCCB uses i2c_master API (I2C_NUM_1, GPIO 12/13)

# LVGL Memory Allocator: switch from 64KB built-in static pool to the standard
# C library allocator (malloc/free), giving LVGL access to the full 16MB PSRAM heap.
# This eliminates the lv_tlsf heap corruption / WDT crash during enrollment.
CONFIG_LV_USE_BUILTIN_MALLOC=n
CONFIG_LV_USE_CLIB_MALLOC=y
```

## sdkconfig.defaults.esp32p4
```kconfig
# ESP-Hosted configuration for the ESP32-P4 Function EV board with the
# on-board ESP32-C6 acting as the Wi-Fi/BLE co-processor over SDIO.

CONFIG_SLAVE_IDF_TARGET_ESP32C6=y
CONFIG_ESP_WIFI_REMOTE_ENABLED=y
CONFIG_ESP_WIFI_REMOTE_LIBRARY_HOSTED=y
CONFIG_ESP_HOSTED_ENABLED=y
CONFIG_ESP_HOSTED_CP_TARGET_ESP32C6=y
CONFIG_ESP_HOSTED_P4_DEV_BOARD_FUNC_BOARD=y
CONFIG_ESP_HOSTED_SDIO_HOST_INTERFACE=y

CONFIG_BT_ENABLED=y
CONFIG_BT_CONTROLLER_DISABLED=y
CONFIG_BT_BLUEDROID_ENABLED=n
CONFIG_BT_NIMBLE_ENABLED=y
CONFIG_BT_NIMBLE_TRANSPORT_UART=n
CONFIG_ESP_HOSTED_ENABLE_BT_NIMBLE=y
CONFIG_ESP_HOSTED_NIMBLE_HCI_VHCI=y

CONFIG_CAMERA_OV5647=y
CONFIG_CAMERA_OV5647_AUTO_DETECT_MIPI_INTERFACE_SENSOR=y
CONFIG_CAMERA_SC2336=y
CONFIG_CAMERA_SC2336_AUTO_DETECT_MIPI_INTERFACE_SENSOR=y
CONFIG_CAMERA_GC2145=y
CONFIG_CAMERA_GC2145_AUTO_DETECT_MIPI_INTERFACE_SENSOR=y
# CONFIG_CAM_MOTOR_DW9714 is not set

CONFIG_ESPTOOLPY_FLASHSIZE_16MB=y
CONFIG_ESPTOOLPY_FLASHSIZE="16MB"
CONFIG_PARTITION_TABLE_CUSTOM=y
CONFIG_PARTITION_TABLE_CUSTOM_FILENAME="partitions.csv"

CONFIG_WIFI_RMT_STATIC_RX_BUFFER_NUM=16
CONFIG_WIFI_RMT_DYNAMIC_RX_BUFFER_NUM=16
CONFIG_WIFI_RMT_DYNAMIC_TX_BUFFER_NUM=16
CONFIG_WIFI_RMT_AMPDU_TX_ENABLED=y
CONFIG_WIFI_RMT_TX_BA_WIN=32
CONFIG_WIFI_RMT_AMPDU_RX_ENABLED=y
CONFIG_WIFI_RMT_RX_BA_WIN=32

CONFIG_LWIP_TCP_SND_BUF_DEFAULT=65534
CONFIG_LWIP_TCP_WND_DEFAULT=65534
CONFIG_LWIP_TCP_RECVMBOX_SIZE=64
CONFIG_LWIP_UDP_RECVMBOX_SIZE=64
CONFIG_LWIP_TCPIP_RECVMBOX_SIZE=64
CONFIG_LWIP_TCP_SACK_OUT=y

# Reserve 64KB internal DMA RAM for SDIO Wi-Fi driver mempool
CONFIG_SPIRAM_MALLOC_RESERVE_INTERNAL=65536
# Use heap allocator instead of static mempool to avoid boot-time DMA exhaustion
CONFIG_ESP_HOSTED_USE_MEMPOOL=n

CONFIG_CAMERA_SC202CS=y
CONFIG_CAMERA_OV2710=y
CONFIG_ESP_MAIN_TASK_STACK_SIZE=16384
CONFIG_FREERTOS_IDLE_TASK_STACKSIZE=768

# SDIO Wi-Fi Co-processor Clock Frequency Stability Fix
CONFIG_ESP_HOSTED_SDIO_CLOCK_FREQ_KHZ=10000
CONFIG_ESP_SDIO_CLOCK_FREQ_KHZ=10000
CONFIG_ESP_HOSTED_SDIO_OPTIMIZATION_RX_NONE=y
CONFIG_ESP_SDIO_OPTIMIZATION_RX_NONE=y

# Enable Long Filenames (LFN) for SD Card FATFS
CONFIG_FATFS_LFN_HEAP=y
CONFIG_FATFS_MAX_LFN=255

# Increase Task Watchdog timeout to 30s: LVGL rendering of complex screens
# can legitimately take longer than the default 5s on PSRAM-based draw buffers.
CONFIG_ESP_TASK_WDT_TIMEOUT_S=30
```
